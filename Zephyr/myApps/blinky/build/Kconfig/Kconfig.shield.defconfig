## Zephyr/myApps/pdm/build/Kconfig/Kconfig.shield.defconfig
```kconfig
osource "c:/Users/benja/OneDrive/Documents/GitHub/Nordic/Zephyr/myApps/peripheral_uart/boards/shields/*/Kconfig.defconfig"
osource "C:/Users/benja/ncs/v1.7.0/nrf/boards/shields/*/Kconfig.defconfig"
```

## Zephyr/myApps/peripheral_uart/build/Kconfig/Kconfig.shield
```kconfig
osource "c:/Users/benja/OneDrive/Documents/GitHub/Nordic/Zephyr/myApps/peripheral_uart/boards/shields/*/Kconfig.shield"
osource "C:/Users/benja/ncs/v1.7.0/nrf/boards/shields/*/Kconfig.shield"
```
